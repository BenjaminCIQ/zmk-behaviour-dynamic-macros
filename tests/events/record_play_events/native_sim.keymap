#include "../behavior_keymap.dtsi"

&kscan {
    events = <
        /* REC */
        ZMK_MOCK_PRESS(0,0,10)
        ZMK_MOCK_RELEASE(0,0,10)
        /* A (recorded) */
        ZMK_MOCK_PRESS(2,0,10)
        ZMK_MOCK_RELEASE(2,0,10)
        /* STP */
        ZMK_MOCK_PRESS(0,1,10)
        ZMK_MOCK_RELEASE(0,1,10)
        /* SLOT_RAM 0 (assign) */
        ZMK_MOCK_PRESS(1,0,10)
        ZMK_MOCK_RELEASE(1,0,10)
        /* SLOT_RAM 0 (play) */
        ZMK_MOCK_PRESS(1,0,2000)
        ZMK_MOCK_RELEASE(1,0,10)
    >;
};
