/*
 * Copyright (c) 2026 The ZMK Contributors
 * SPDX-License-Identifier: MIT
 *
 * Test: Attempt to play an empty slot.
 *
 * Sequence:
 * 1. Press slot 0 (never recorded anything)
 *
 * Expected: No playback, error feedback (if enabled)
 */

#include <behaviors.dtsi>
#include <dt-bindings/zmk/keys.h>
#include <dt-bindings/zmk/kscan_mock.h>
#include <dt-bindings/zmk/dynamic_macros.h>
#include "../behavior_keymap.dtsi"

/ {
    keymap {
        compatible = "zmk,keymap";
        default_layer {
            bindings = <
                &dm DM_SLOT_NVS 0
                &dm DM_SLOT_RAM 0
            >;
        };
    };
};

&kscan {
    events = <
        /* Try to play empty NVS slot */
        ZMK_MOCK_PRESS(0,0,100)
        ZMK_MOCK_RELEASE(0,0,110)

        /* Try to play empty RAM slot */
        ZMK_MOCK_PRESS(0,1,500)
        ZMK_MOCK_RELEASE(0,1,510)
    >;
};
