#include "../behavior_keymap.dtsi"

&kscan {
    events = <
        /* REC */
        ZMK_MOCK_PRESS(0,0,10)
        ZMK_MOCK_RELEASE(0,0,10)
        /* A (recorded) */
        ZMK_MOCK_PRESS(3,0,10)
        ZMK_MOCK_RELEASE(3,0,10)
        /* STP */
        ZMK_MOCK_PRESS(0,1,10)
        ZMK_MOCK_RELEASE(0,1,10)
        /* SLOT_RAM 0 (assign) */
        ZMK_MOCK_PRESS(1,0,10)
        ZMK_MOCK_RELEASE(1,0,10)
        /* MOV */
        ZMK_MOCK_PRESS(2,1,10)
        ZMK_MOCK_RELEASE(2,1,10)
        /* SLOT_RAM 0 (source) */
        ZMK_MOCK_PRESS(1,0,10)
        ZMK_MOCK_RELEASE(1,0,10)
        /* SLOT_RAM 1 (destination) */
        ZMK_MOCK_PRESS(1,1,10)
        ZMK_MOCK_RELEASE(1,1,10)
        /* SLOT_RAM 1 (play from new location) */
        ZMK_MOCK_PRESS(1,1,2000)
        ZMK_MOCK_RELEASE(1,1,10)
    >;
};
