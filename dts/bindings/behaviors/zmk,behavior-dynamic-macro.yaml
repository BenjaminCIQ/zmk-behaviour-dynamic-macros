## dts/bindings/behaviors/zmk,behavior-dynamic-macro.yaml
```yaml
# Copyright (c) 2026 The ZMK Contributors
# SPDX-License-Identifier: MIT

description: Dynamic Macro behavior

compatible: "zmk,behavior-dynamic-macro"

include: two_param.yaml
```
